## conf/bblayers.conf
```bitbake
# Copyright (C) 2024 The Qt Company Ltd.
# SPDX-License-Identifier: LicenseRef-Qt-Commercial OR GPL-3.0-only

# POKY_BBLAYERS_CONF_VERSION is increased each time build/conf/bblayers.conf
# changes incompatibly
POKY_BBLAYERS_CONF_VERSION = "2"

BBPATH = "${TOPDIR}"
BBFILES ?= ""
BSPDIR := "${@os.path.abspath(os.path.dirname(d.getVar('FILE')) + '/../..')}"

BBLAYERS ?= " \
  ${BSPDIR}/sources/poky/meta \
  ${BSPDIR}/sources/poky/meta-poky \
  ${BSPDIR}/sources/meta-arm/meta-arm \
  ${BSPDIR}/sources/meta-arm/meta-arm-bsp \
  ${BSPDIR}/sources/meta-arm/meta-arm-systemready \
  ${BSPDIR}/sources/meta-arm/meta-arm-toolchain \
  ${BSPDIR}/sources/meta-freescale \
  ${BSPDIR}/sources/meta-freescale-3rdparty \
  ${BSPDIR}/sources/meta-freescale-distro \
  ${BSPDIR}/sources/meta-openembedded/meta-oe \
  ${BSPDIR}/sources/meta-openembedded/meta-python \
  ${BSPDIR}/sources/meta-openembedded/meta-networking \
  ${BSPDIR}/sources/meta-openembedded/meta-initramfs \
  ${BSPDIR}/sources/meta-openembedded/meta-multimedia \
  ${BSPDIR}/sources/meta-openembedded/meta-filesystems \
  ${BSPDIR}/sources/meta-lts-mixins \
  ${BSPDIR}/sources/meta-browser/meta-chromium \
  ${BSPDIR}/sources/meta-security \
  ${BSPDIR}/sources/meta-timesys \
  ${BSPDIR}/sources/meta-virtualization \
  ${BSPDIR}/sources/meta-clang \
  ${BSPDIR}/sources/meta-boot2qt/meta-boot2qt \
  ${BSPDIR}/sources/meta-boot2qt/meta-boot2qt-distro \
  ${BSPDIR}/sources/meta-mingw \
  ${BSPDIR}/sources/meta-qt6 \
  ${BSPDIR}/sources/meta-swupdate \
  ${BSPDIR}/sources/meta-imx/meta-imx-bsp \
  ${BSPDIR}/sources/meta-imx/meta-imx-cockpit \
  ${BSPDIR}/sources/meta-imx/meta-imx-ml \
  ${BSPDIR}/sources/meta-imx/meta-imx-sdk \
  ${BSPDIR}/sources/meta-imx/meta-imx-v2x \
  ${BSPDIR}/sources/meta-variscite-bsp-common \
  ${BSPDIR}/sources/meta-variscite-bsp-imx \
  ${BSPDIR}/sources/meta-variscite-hab \
  ${BSPDIR}/sources/meta-variscite-sdk-common \
  ${BSPDIR}/sources/meta-variscite-sdk-imx \
  ${BSPDIR}/sources/meta-nxp-connectivity/meta-nxp-otbr \
  ${BSPDIR}/sources/meta-nxp-connectivity/meta-nxp-matter-advanced \
  ${BSPDIR}/sources/meta-nxp-connectivity/meta-nxp-matter-baseline \
  ${BSPDIR}/sources/meta-nxp-connectivity/meta-nxp-zigbee-rcp \
  ${BSPDIR}/sources/meta-nxp-demo-experience \
  "

BBMASK += "${BSPDIR}/sources/meta-browser/meta-chromium/recipes-browser/chromium/gn-native_.*\.bb"
# 
# ${BSPDIR}/sources/meta-nxp-connectivity/meta-nxp-openthread 
# ${BSPDIR}/sources/meta-browser/meta-firefox
```
